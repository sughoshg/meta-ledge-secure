## meta-ledge-secure/conf/layer.conf
```bitbake
# We have a conf and classes directory, add to BBPATH
BBPATH .= ":${LAYERDIR}"

# We have recipes-* directories, add to BBFILES
BBFILES += "${LAYERDIR}/recipes-*/*/*.bb \
            ${LAYERDIR}/recipes-*/*/*.bbappend"

BBFILE_COLLECTIONS += "meta-ledge-secure"
BBFILE_PATTERN_meta-ledge-secure = "^${LAYERDIR}/"
BBFILE_PRIORITY_meta-ledge-secure = "9"

#LAYERDEPENDS_meta-ledge-secure = " \
#    meta-trustedsubstrate \
#"
LAYERSERIES_COMPAT_meta-arm = "hardknott"

# enable selinux
DISTRO_FEATURES_append = "acl xattr pam selinux"
PACKAGECONFIG_pn-sudo = "pam-wheel"

# set permissive mode for now. We can change this to enforcing once we have the
# proper policy installed
#DEFAULT_ENFORCING = "enforcing"
DEFAULT_ENFORCING = "permissive"
PREFERRED_PROVIDER_virtual/refpolicy = "refpolicy-mls"
DISTRO_FEATURES_append = " systemd "

# enable EFI
DISTRO_FEATURES_append = " efi"

# enable udisks2 (for clevis)
DISTRO_FEATURES_append = " polkit"
```

## meta-ledge-secure/conf/machine/ledge-secure-qemuarm64.conf
```bitbake
MACHINEOVERRIDES =. "qemuarm64:"

require ${COREBASE}/meta/conf/machine/qemuarm64.conf

KMACHINE = "qemuarm64"

UBOOT_MACHINE = "qemu_arm64_defconfig"

QB_MACHINE = "-machine virt,secure=on"
QB_OPT_APPEND += "-no-acpi"
QB_MEM = "-m 2048"
QB_DEFAULT_FSTYPE = "wic"
QB_DEFAULT_BIOS = "flash.bin"
QB_FSINFO = "wic:no-kernel-in-fs"
QB_ROOTFS_OPT = ""

KERNEL_IMAGETYPE = "Image"
PREFERRED_PROVIDER_virtual/kernel = "linux-yocto"
PREFERRED_VERSION_linux-yocto = "5.15%"

IMAGE_FSTYPES = "wic.xz"

INITRAMFS_IMAGE = "ledge-initramfs"
WKS_FILE_DEPENDS += "ledge-initramfs"
do_image_wic[depends] += "ledge-initramfs:do_image_complete"
WKS_FILE = "ledge-secure.wks.in"
IMAGE_BOOT_FILES = "${KERNEL_IMAGETYPE}"

MACHINE_FEATURES:append = " optee-ftpm"
MACHINE_FEATURES:append = " optee"
MACHINE_FEATURES:append = " tpm2"
```
